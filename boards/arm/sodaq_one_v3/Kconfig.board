## boards/arm/sodaq_one_v3/Kconfig.board
```kconfig
# Kconfig - SODAQ One v3 board configuration
#
# Copyright (c) 2018 Henrik Brix Andersen <henrik@brixandersen.dk>
#
# SPDX-License-Identifier: Apache-2.0

config BOARD_SODAQ_ONE_V3
	bool "SODAQ One v3"
	depends on SOC_PART_NUMBER_SAMD21G18A
```

## boards/arm/sodaq_one_v3/Kconfig.defconfig
```kconfig
# Kconfig - SODAQ One v3 board configuration
#
# Copyright (c) 2018 Henrik Brix Andersen <henrik@brixandersen.dk>
#
# SPDX-License-Identifier: Apache-2.0

if BOARD_SODAQ_ONE_V3

config BOARD
	default "sodaq_one_v3"

endif
```

## drivers/gpio/Kconfig.sam0
```kconfig
# Kconfig.sam0 - Atmel SAM0 GPIO configuration options
#
# Copyright (c) 2017 Google LLC.
# SPDX-License-Identifier: Apache-2.0

menuconfig GPIO_SAM0
	bool "Atmel SAM0 GPIO (PORT) driver"
	depends on GPIO && SOC_FAMILY_SAM0
	default n
	help
	  Enable support for the Atmel SAM0 'PORT' GPIO controllers.

if GPIO_SAM0

config SYS_LOG_GPIO_SAM0_LEVEL
	int
	prompt "SAM0 driver log level"
	depends on GPIO_SAM0 && SYS_LOG
	default 0
	help
	  Sets log level for GPIO SAM0 driver

	  Levels are:

	  - 0 OFF, do not write

	  - 1 ERROR, only write SYS_LOG_ERR

	  - 2 WARNING, write SYS_LOG_WRN in addition to previous level

	  - 3 INFO, write SYS_LOG_INF in addition to previous levels

	  - 4 DEBUG, write SYS_LOG_DBG in addition to previous levels

endif #GPIO_SAM0
```

## drivers/i2c/Kconfig.sam0
```kconfig
# Kconfig - Atmel SAM0 SERCOM I2C
#
# Copyright (c) 2017 Google LLC.
# SPDX-License-Identifier: Apache-2.0

menuconfig I2C_SAM0
	bool "Atmel SAM0 series SERCOM I2C driver"
	depends on SOC_FAMILY_SAM0
	select HAS_DTS_I2C	
	default n
	help
	  Enable support for the SAM0 SERCOM I2C driver.
```

## drivers/interrupt_controller/Kconfig.sam0
```kconfig
# Kconfig - SAM0 EXTI configuration
#
# Copyright (c) 2018 Léonard Bise
#
# SPDX-License-Identifier: Apache-2.0
#

config EXTI_SAM0
	bool "External Interrupt Controller (EXTI) Driver for SAM0 family of MCUs"
	default y if SOC_FAMILY_SAM0
	help
	 Enable EXTI driver for SAM0 line of MCUs

if EXTI_SAM0

config SYS_LOG_EXTI_SAM0_LEVEL
	int
	prompt "SAM0 driver log level"
	depends on EXTI_SAM0 && SYS_LOG
	default 0
	help
	  Sets log level for EXTI SAM0 driver

	  Levels are:

	  - 0 OFF, do not write

	  - 1 ERROR, only write SYS_LOG_ERR

	  - 2 WARNING, write SYS_LOG_WRN in addition to previous level

	  - 3 INFO, write SYS_LOG_INF in addition to previous levels

	  - 4 DEBUG, write SYS_LOG_DBG in addition to previous levels

endif #EXTI_SAM0
```

## dts/bindings/interrupt-controller/atmel,sam0-eic.yaml
```yaml
---
title: Atmel SAM0 External Interrupt Controller driver
id: atmel,sam0-eic
version: 0.1

description: >
    This is a representation of the SAM0 External Interrupt Controller nodes

properties:
    compatible:
      type: string
      category: required
      description: compatible strings
      constraint: "atmel,sam0-eic"

    reg:
      type: int
      description: mmio register space
      generation: define
      category: required

    label:
      type: string
      category: required
      description: Human readable string describing the device (used by Zephyr for API name)
      generation: define

    interrupts:
      type: array
      category: required
      description: required interrupts
      generation: define
```
